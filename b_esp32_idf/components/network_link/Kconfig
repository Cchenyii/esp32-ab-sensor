## b_esp32_idf/components/network_link/Kconfig
```kconfig
menu "A board Wi-Fi and TCP link"
    config APP_WIFI_MODEM_SLEEP
        bool "Enable Wi-Fi modem sleep"
        default n
        help
            Disabling modem sleep reduces TCP and multicast receive latency
            on this USB-powered gateway, at the cost of greater power use.
    config APP_SENSOR_STALE_MS
        int "Invalidate sensor snapshot after no new data (ms)"
        range 4000 20000
        default 6000
    config APP_TCP_VALID_TIMEOUT_MS
        int "Close connection after no new valid sensor data (ms)"
        range 10000 60000
        default 20000
endmenu
```

## b_esp32_idf/components/ota_service/Kconfig
```kconfig
menu "Local OTA"
    config OTA_DIAGNOSTIC_FAIL_HEALTH
        bool "Diagnostic image: deliberately fail pending-image health check"
        default n
        help
            Only for an explicit hardware rollback acceptance run. A pending
            image built with this option rolls back after ten seconds.
            Leave disabled for normal firmware.
endmenu
```

## b_esp32_idf/components/uart_link/Kconfig
```kconfig
menu "STM32 UART link"
    config APP_UART_ALLOW_LEGACY
        bool "Accept original STM32 V1 joystick frames before session handshake"
        default y
        help
            Transitional compatibility only. Reboot-safe deduplication requires
            the STM32 session firmware. Legacy frames are blocked after a
            session is confirmed.
endmenu
```

## b_esp32_idf/main/Kconfig.projbuild
```kconfig
menu "B board bring-up"
    config APP_BOOT_BUTTON_GPIO
        int "Active-low button GPIO (default: BOOT on GPIO0)"
        range 0 33
        default 0
        help
            Confirm this GPIO against your board schematic. Do not select
            GPIO6 through GPIO11: these pins are normally used by flash.
            The input uses an internal pull-up; no LED is required.

    config APP_HEARTBEAT_PERIOD_MS
        int "Heartbeat log interval (milliseconds)"
        range 100 60000
        default 1000
endmenu
```

## b_esp32_idf/sdkconfig.defaults
```kconfig
CONFIG_IDF_TARGET="esp32"
CONFIG_ESPTOOLPY_FLASHMODE_DIO=y
CONFIG_ESPTOOLPY_FLASHFREQ_40M=y
CONFIG_ESPTOOLPY_FLASHSIZE_4MB=y
CONFIG_ESP_CONSOLE_UART_DEFAULT=y
CONFIG_ESP_CONSOLE_UART_BAUDRATE=115200
CONFIG_LOG_DEFAULT_LEVEL_INFO=y
CONFIG_FREERTOS_HZ=1000
CONFIG_PARTITION_TABLE_CUSTOM=y
CONFIG_PARTITION_TABLE_CUSTOM_FILENAME="partitions.csv"
CONFIG_APP_BOOT_BUTTON_GPIO=0
CONFIG_APP_HEARTBEAT_PERIOD_MS=1000
CONFIG_MBEDTLS_CERTIFICATE_BUNDLE=y
CONFIG_MBEDTLS_CERTIFICATE_BUNDLE_DEFAULT_FULL=y
CONFIG_MQTT_USE_CUSTOM_CONFIG=y
CONFIG_MQTT_OUTBOX_EXPIRED_TIMEOUT_MS=5000
CONFIG_LWIP_SNTP_MAX_SERVERS=3
CONFIG_BOOTLOADER_APP_ROLLBACK_ENABLE=y
```
